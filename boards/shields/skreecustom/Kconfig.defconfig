## boards/shields/skreecustom/Kconfig.defconfig
```kconfig
# ============================================================================
# Left Half Configuration (Central)
# ============================================================================
if SHIELD_SKREECUSTOM_LEFT

config ZMK_KEYBOARD_NAME
    default "ZMK Birk"

config ZMK_SPLIT_ROLE_CENTRAL
    default y

endif # SHIELD_SKREECUSTOM_LEFT

# ============================================================================
# Common Configuration (Both Halves)
# ============================================================================
if SHIELD_SKREECUSTOM_LEFT || SHIELD_SKREECUSTOM_RIGHT

config ZMK_SPLIT
    default y

config ZMK_SLEEP
    default y

# SPI required for shift register
config SPI
    default y

# RGB underglow (always enabled)
config ZMK_RGB_UNDERGLOW
    default y

# Don't require external power for RGB
config ZMK_RGB_UNDERGLOW_EXT_POWER
    default n

# Matrix scan timing optimization
config ZMK_KSCAN_MATRIX_WAIT_BEFORE_INPUTS
    default 0

config ZMK_KSCAN_MATRIX_WAIT_BETWEEN_OUTPUTS
    default 1

endif # SHIELD_SKREECUSTOM_LEFT || SHIELD_SKREECUSTOM_RIGHT

# ============================================================================
# Pointing (Trackball) - enabled when either trackball shield is present
# ============================================================================
if SHIELD_SKREECUSTOM_TRACKBALL_LEFT || SHIELD_SKREECUSTOM_TRACKBALL_RIGHT

config ZMK_POINTING
    default y

endif # TRACKBALL

if SHIELD_DONGLE

# Max 16 characters in keyboard name
config ZMK_KEYBOARD_NAME
    default "Birk ZMK Dongle"

config ZMK_SPLIT_ROLE_CENTRAL
    default y

config ZMK_SPLIT
    default y

# Set this to the number of peripherals your dongle will have.
# For a unibody, this would be 1. If you have left and right halves, set it to 2, etc.
config ZMK_SPLIT_BLE_CENTRAL_PERIPHERALS
    default 2

# Set this to ZMK_SPLIT_BLE_CENTRAL_PERIPHERALS + your desired number of BT profiles (default is 5)
config BT_MAX_CONN
    default 6

# Set this to the same number as BT_MAX_CONN
config BT_MAX_PAIRED
    default 6

config ZMK_RGB_UNDERGLOW_EXT_POWER
    default n

endif
```

## boards/shields/skreecustom/Kconfig.shield
```kconfig
# Shield definitions for skreecustom

config SHIELD_SKREECUSTOM_LEFT
    def_bool $(shields_list_contains,skreecustom_left)

config SHIELD_SKREECUSTOM_RIGHT
    def_bool $(shields_list_contains,skreecustom_right)

config SHIELD_DONGLE
    def_bool $(shields_list_contains,dongle)
```
